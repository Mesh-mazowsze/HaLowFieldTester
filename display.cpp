#include "display.h"
#include "logbuf.h"

#include <SPI.h>

#define NV_SWRESET 0x01
#define NV_RDDID   0x04
#define NV_SLPOUT  0x11
#define NV_INVOFF  0x20
#define NV_DISPON  0x29
#define NV_CASET   0x2A
#define NV_RASET   0x2B
#define NV_RAMWR   0x2C
#define NV_MADCTL  0x36
#define NV_COLMOD  0x3A
#define NV_RDID1   0xDA
#define NV_RDID2   0xDB
#define NV_RDID3   0xDC

#define NV_ID_NV3001B 0x300101

static bool s_present = false;
static SPIClass *s_spi = NULL;

/* ------------------------------------------------------------------ */
/* Bit-banged ID read (runs before SPI is configured)                  */
/* ------------------------------------------------------------------ */

static inline void nvDelay(void) { delayMicroseconds(2); }

static void nvWriteCmdForRead(uint8_t cmd) {
  pinMode(TFT_PIN_SDA, OUTPUT);
  digitalWrite(TFT_PIN_DC, LOW);
  for (uint8_t mask = 0x80; mask; mask >>= 1) {
    digitalWrite(TFT_PIN_SCL, LOW);
    digitalWrite(TFT_PIN_SDA, (cmd & mask) ? HIGH : LOW);
    nvDelay();
    digitalWrite(TFT_PIN_SCL, HIGH);
    nvDelay();
    if (mask == 0x01) {
      /* Turn the line around for the reply on the last clock. */
      digitalWrite(TFT_PIN_DC, HIGH);
      pinMode(TFT_PIN_SDA, INPUT);
      nvDelay();
    }
  }
  digitalWrite(TFT_PIN_SCL, LOW);
  nvDelay();
}

static uint8_t nvReadBit(void) {
  digitalWrite(TFT_PIN_SCL, HIGH);
  nvDelay();
  uint8_t b = digitalRead(TFT_PIN_SDA) ? 1 : 0;
  digitalWrite(TFT_PIN_SCL, LOW);
  nvDelay();
  return b;
}

static uint8_t nvReadByte(void) {
  uint8_t d = 0;
  for (uint8_t i = 0; i < 8; i++) d = (uint8_t)((d << 1) | nvReadBit());
  return d;
}

static void nvReadRegister(uint8_t cmd, uint8_t *out, uint8_t len, bool skipBit) {
  digitalWrite(TFT_PIN_CS, LOW);
  nvWriteCmdForRead(cmd);
  if (skipBit) (void)nvReadBit();
  for (uint8_t i = 0; i < len; i++) out[i] = nvReadByte();
  pinMode(TFT_PIN_SDA, OUTPUT);
  digitalWrite(TFT_PIN_SDA, HIGH);
  digitalWrite(TFT_PIN_CS, HIGH);
  digitalWrite(TFT_PIN_DC, HIGH);
  digitalWrite(TFT_PIN_SCL, LOW);
}

uint32_t dispProbeId(void) {
  /* Power the panel: EN is active low. */
  pinMode(TFT_PIN_EN, OUTPUT); digitalWrite(TFT_PIN_EN, LOW);
  pinMode(TFT_PIN_BL, OUTPUT); digitalWrite(TFT_PIN_BL, HIGH);
  delay(50);

  pinMode(TFT_PIN_CS,  OUTPUT);
  pinMode(TFT_PIN_SCL, OUTPUT);
  pinMode(TFT_PIN_SDA, OUTPUT);
  pinMode(TFT_PIN_DC,  OUTPUT);
  pinMode(TFT_PIN_RST, OUTPUT);
  digitalWrite(TFT_PIN_CS,  HIGH);
  digitalWrite(TFT_PIN_DC,  HIGH);
  digitalWrite(TFT_PIN_SCL, LOW);
  digitalWrite(TFT_PIN_SDA, HIGH);
  digitalWrite(TFT_PIN_RST, HIGH);
  delay(100);
  digitalWrite(TFT_PIN_RST, LOW);  delay(120);
  digitalWrite(TFT_PIN_RST, HIGH); delay(120);

  uint8_t rddid[3] = {0}, rdid[3] = {0};
  nvReadRegister(NV_RDDID, rddid, 3, true);
  nvReadRegister(NV_RDID1, &rdid[0], 1, false);
  nvReadRegister(NV_RDID2, &rdid[1], 1, false);
  nvReadRegister(NV_RDID3, &rdid[2], 1, false);

  uint32_t a = ((uint32_t)rddid[0] << 16) | ((uint32_t)rddid[1] << 8) | rddid[2];
  uint32_t b = ((uint32_t)rdid[0]  << 16) | ((uint32_t)rdid[1]  << 8) | rdid[2];

  LOGI("TFT", "RDDID=0x%06lX RDID=0x%06lX", (unsigned long)a, (unsigned long)b);
  if (a == NV_ID_NV3001B) return a;
  if (b == NV_ID_NV3001B) return b;
  return a ? a : b;
}

/* ------------------------------------------------------------------ */
/* Hardware SPI                                                        */
/* ------------------------------------------------------------------ */

static void wrCmd(uint8_t c) {
  digitalWrite(TFT_PIN_DC, LOW);
  digitalWrite(TFT_PIN_CS, LOW);
  s_spi->transfer(c);
  digitalWrite(TFT_PIN_CS, HIGH);
}

static void wrData(const uint8_t *d, size_t n) {
  digitalWrite(TFT_PIN_DC, HIGH);
  digitalWrite(TFT_PIN_CS, LOW);
  for (size_t i = 0; i < n; i++) s_spi->transfer(d[i]);
  digitalWrite(TFT_PIN_CS, HIGH);
}

static void wrCmdData(uint8_t c, const uint8_t *d, size_t n) {
  wrCmd(c);
  if (n) wrData(d, n);
}

#define C1(C, A)    do { const uint8_t d[] = { (uint8_t)(A) };               wrCmdData((C), d, 1); } while (0)
#define C2(C, A, B) do { const uint8_t d[] = { (uint8_t)(A), (uint8_t)(B) }; wrCmdData((C), d, 2); } while (0)

/* Register block as used by Arduino_NV3001B (Quency-D fork). */
static void initPanel(void) {
  wrCmd(NV_SWRESET);
  delay(120);

  C1(0xFF, 0xA5); C1(0x41, 0x00); C1(0x50, 0x02); C1(0x52, 0x6E);
  C1(0x57, 0x02); C1(0x46, 0x11); C2(0x47, 0x00, 0x01); C2(0x8F, 0x22, 0x03);
  C1(0x9A, 0x78); C1(0x9B, 0x78); C1(0x9C, 0xA0); C1(0x9D, 0x17);
  C1(0x9E, 0xC1); C1(0x83, 0x5A); C1(0x84, 0xB6); C1(0xFF, 0xA5);
  C1(0x85, 0x5F); C1(0x6E, 0x0F); C1(0x7E, 0x0F); C1(0x60, 0x00);
  C1(0x70, 0x00); C1(0x6D, 0x33); C1(0x7D, 0x37); C1(0x61, 0x09);
  C1(0x71, 0x0A); C1(0x6C, 0x2A); C1(0x7C, 0x36); C1(0x62, 0x11);
  C1(0x72, 0x10); C1(0x68, 0x4E); C1(0x78, 0x4E); C1(0x66, 0x36);
  C1(0x76, 0x3C); C1(0x1A, 0x1C); C1(0x7B, 0x14); C1(0x63, 0x0D);
  C1(0x73, 0x0A); C1(0x6A, 0x16); C1(0x7A, 0x12); C1(0x64, 0x0B);
  C1(0x74, 0x0A); C1(0x69, 0x08); C1(0x79, 0x0A); C1(0x65, 0x06);
  C1(0x75, 0x07); C1(0x67, 0x23); C1(0x77, 0x44); C1(0xE0, 0x00);
  C1(0xE9, 0x30); C1(0xEB, 0xB7); C1(0xEC, 0x00); C1(0xED, 0x11);
  C1(0xF0, 0xB7); C1(0x53, 0x04); C1(0x54, 0x04); C1(0x55, 0x40);
  C1(0x56, 0x40); C2(0xA0, 0x60, 0x01); C1(0xA1, 0x84); C1(0xA2, 0x85);
  C2(0xAB, 0x00, 0x02); C2(0xAC, 0x00, 0x06); C2(0xAD, 0x00, 0x03);
  C2(0xAE, 0x00, 0x07); C1(0xC7, 0x01); C1(0xB9, 0x82); C1(0xBA, 0x83);
  C1(0xBB, 0x00); C1(0xBC, 0x81); C1(0xBD, 0x02); C1(0xBE, 0x01);
  C1(0xBF, 0x04); C1(0xC0, 0x03); C1(0xC8, 0x55); C1(0xC9, 0xC9);
  C1(0xCA, 0xC8); C1(0xCB, 0xCB); C1(0xCC, 0xCA); C1(0xCD, 0x55);
  C1(0xCE, 0xCE); C1(0xCF, 0xCD); C1(0xD0, 0xD0); C1(0xD1, 0xCF);
  C1(0xF2, 0x46); C1(0xA8, 0x04); C1(0xA9, 0xB0); C1(0xAA, 0xA3);
  C1(0xB6, 0x00); C1(0xB7, 0xB0); C1(0xB8, 0xA3); C1(0xC4, 0x03);
  C1(0xC5, 0xB0); C1(0xC6, 0xA3); C1(0x80, 0x10); C1(0xFF, 0x00);
  C1(0x35, 0x00);

  wrCmd(NV_SLPOUT); delay(120);
  C1(NV_COLMOD, 0x05);   /* 16-bit RGB565 */
  C1(NV_MADCTL, 0x00);   /* rotation 0, the panel is physically portrait */
  wrCmd(NV_DISPON); delay(10);
  wrCmd(NV_INVOFF);
  C1(NV_MADCTL, 0x00);
}

bool dispInit(void) {
  uint32_t id = dispProbeId();
  if (id != NV_ID_NV3001B) {
    LOGW("TFT", "no NV3001B found (id 0x%06lX) - display disabled",
         (unsigned long)id);
    s_present = false;
    return false;
  }

  pinMode(TFT_PIN_CS, OUTPUT);  digitalWrite(TFT_PIN_CS, HIGH);
  pinMode(TFT_PIN_DC, OUTPUT);  digitalWrite(TFT_PIN_DC, HIGH);
  pinMode(TFT_PIN_RST, OUTPUT);
  digitalWrite(TFT_PIN_RST, HIGH); delay(10);
  digitalWrite(TFT_PIN_RST, LOW);  delay(20);
  digitalWrite(TFT_PIN_RST, HIGH); delay(120);

  s_spi = new SPIClass(HSPI);
  s_spi->begin(TFT_PIN_SCL, -1, TFT_PIN_SDA, -1);   /* CS driven by hand */
  s_spi->beginTransaction(SPISettings(4000000, MSBFIRST, SPI_MODE0));

  initPanel();
  s_present = true;
  LOGI("TFT", "NV3001B ready, %dx%d", TFT_W, TFT_H);
  return true;
}

bool dispPresent(void) { return s_present; }

void dispBacklight(bool on) {
  pinMode(TFT_PIN_BL, OUTPUT);
  digitalWrite(TFT_PIN_BL, on ? HIGH : LOW);
}

static void setWindow(int16_t x, int16_t y, int16_t w, int16_t h) {
  uint8_t d[4];
  d[0] = (uint8_t)(x >> 8); d[1] = (uint8_t)x;
  d[2] = (uint8_t)((x + w - 1) >> 8); d[3] = (uint8_t)(x + w - 1);
  wrCmdData(NV_CASET, d, 4);
  d[0] = (uint8_t)(y >> 8); d[1] = (uint8_t)y;
  d[2] = (uint8_t)((y + h - 1) >> 8); d[3] = (uint8_t)(y + h - 1);
  wrCmdData(NV_RASET, d, 4);
  wrCmd(NV_RAMWR);
}

void dispFillRect(int16_t x, int16_t y, int16_t w, int16_t h, uint16_t colour) {
  if (!s_present) return;
  if (x < 0) { w += x; x = 0; }
  if (y < 0) { h += y; y = 0; }
  if (x + w > TFT_W) w = TFT_W - x;
  if (y + h > TFT_H) h = TFT_H - y;
  if (w <= 0 || h <= 0) return;

  setWindow(x, y, w, h);
  uint8_t hi = (uint8_t)(colour >> 8), lo = (uint8_t)colour;
  digitalWrite(TFT_PIN_DC, HIGH);
  digitalWrite(TFT_PIN_CS, LOW);
  for (int32_t i = 0; i < (int32_t)w * h; i++) {
    s_spi->transfer(hi);
    s_spi->transfer(lo);
  }
  digitalWrite(TFT_PIN_CS, HIGH);
}

void dispFill(uint16_t colour) {
  dispFillRect(0, 0, TFT_W, TFT_H, colour);
}

/* Minimal 5x7 font, ASCII 32..126. */
static const uint8_t FONT5X7[][5] PROGMEM = {
  {0x00,0x00,0x00,0x00,0x00},{0x00,0x00,0x5F,0x00,0x00},{0x00,0x07,0x00,0x07,0x00},
  {0x14,0x7F,0x14,0x7F,0x14},{0x24,0x2A,0x7F,0x2A,0x12},{0x23,0x13,0x08,0x64,0x62},
  {0x36,0x49,0x55,0x22,0x50},{0x00,0x05,0x03,0x00,0x00},{0x00,0x1C,0x22,0x41,0x00},
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  {0x00,0x41,0x36,0x08,0x00},{0x08,0x08,0x2A,0x1C,0x08},
};

void dispText(int16_t x, int16_t y, const char *s, uint16_t fg, uint16_t bg,
              uint8_t scale) {
  if (!s_present || !s) return;
  if (scale < 1) scale = 1;

  for (; *s; s++) {
    uint8_t c = (uint8_t)*s;
    if (c < 32 || c > 126) c = '?';
    const uint8_t *g = FONT5X7[c - 32];

    for (uint8_t col = 0; col < 6; col++) {
      uint8_t bits = (col < 5) ? pgm_read_byte(&g[col]) : 0x00;
      for (uint8_t row = 0; row < 8; row++) {
        uint16_t colour = (bits & (1 << row)) ? fg : bg;
        if (colour == bg && bg == TFT_BLACK && !(bits & (1 << row))) {
          /* still paint, so text overwrites cleanly */
        }
        dispFillRect((int16_t)(x + col * scale), (int16_t)(y + row * scale),
                     scale, scale, colour);
      }
    }
    x += 6 * scale;
    if (x > TFT_W) return;
  }
}
